## conf/layer.conf
```bitbake
# It really depends on order of the layers appearing in BBLAYERS
# variable in toplevel bblayers.conf file, where bitbake will search
# We have a conf and classes directory, add to BBPATH
BBPATH .= ":${LAYERDIR}"
# We have recipes-* directories, add to BBFILES
BBFILES += "${LAYERDIR}/recipes-*/*/*.bb*"

BBFILE_COLLECTIONS += "commschamp"
BBFILE_PATTERN_commschamp = "^${LAYERDIR}/"

## Layer priority - the higher number the higher priority.
BBFILE_PRIORITY_commschamp = "100"

# This should only be incremented on significant changes that will
# cause compatibility issues with other layers
LAYERVERSION_commschamp = "1"

LAYERDEPENDS_commschamp = "core"

# The recipes / sources are generic and expected to be compativle
# with any yocto release.
LAYERSERIES_COMPAT_commschamp = "\
    thud \
    warrior \
    zeus \
    dunfell \
    gatesgarth \
    hardknott \
    honister \
    kirkstone \
    langdale \
    mickledore \
"
```
